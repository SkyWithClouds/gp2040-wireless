## CMakeLists.txt
```
cmake_minimum_required(VERSION 3.20.0)
if(NOT BRIDGE_STAGE MATCHES "^(esb|full)$")
  message(FATAL_ERROR "The transmitter supports esb and full")
endif()
find_package(Zephyr REQUIRED HINTS $ENV{ZEPHYR_BASE})
project(bridge_radio_tx)
target_include_directories(app PRIVATE ../common)
target_sources(app PRIVATE src/main.c src/spi.c src/transmitter.c ../common/air.c)
if(BRIDGE_STAGE STREQUAL "esb")
  target_compile_definitions(app PRIVATE BRIDGE_DEMO=1)
endif()

target_sources(app PRIVATE ../common/match.c ../common/match_usb.c)
```

## prj.conf
```kconfig
CONFIG_ESB=y
CONFIG_ENTROPY_GENERATOR=y
CONFIG_ENTROPY_DEVICE_RANDOM_GENERATOR=y
CONFIG_NRFX_SPIS2=y
CONFIG_NRFX_GPIOTE0=y
CONFIG_CONSOLE=n
CONFIG_SERIAL=n
CONFIG_LOG=n

CONFIG_FLASH=y
CONFIG_FLASH_MAP=y
CONFIG_FLASH_PAGE_LAYOUT=y
CONFIG_NVS=y
CONFIG_NVS_DATA_CRC=y
CONFIG_ESB_TX_FIFO_SIZE=32
CONFIG_ESB_RX_FIFO_SIZE=32

CONFIG_USB_DEVICE_STACK=y
CONFIG_USB_SELF_POWERED=n
CONFIG_USB_DEVICE_PID=0x0009
CONFIG_USB_DEVICE_VID=0x1209
CONFIG_USB_DEVICE_PRODUCT="Bridge TX setup"
```

## src/main.c
```c
/* SPDX-License-Identifier: MIT */
#include <zephyr/kernel.h>
#include "air.h"
#include "match_usb.h"
#include "spi.h"
#include "transmitter.h"

#ifdef BRIDGE_DEMO
struct demo_source {
	struct gp_input queue[GP_QUEUE_SIZE];
	uint16_t produced, released, last_buttons;
	uint32_t last_heartbeat, heartbeat;
};

/* Absolute time allows reconnection at the current step without replaying history. */
static uint16_t demo_buttons(uint32_t now, const struct gp_status *s)
{
	uint32_t phase = now % 8000;
	if (phase < 1000) return 0;
	if (phase < 3000) return 0x1000;
	if (phase < 4000) return 0x3000;
	if (phase < 5000) return 0;
	if (phase < 5004) return 0x1000;
	if (phase < 5008) return 0x3000;
	if (phase < 5012) return 0x2000;
	if (phase < 6000) return 0;
	if (phase < 7000) return 0x0008;
	if (!(s->flags & GP_LED_VALID)) return 0;
	uint8_t mode = s->led_mode;
	if (mode >= 2 && mode <= 5) return 0x1000u << (mode - 2);
	if (mode >= 6 && mode <= 9) return 0x1000u << (mode - 6);
	return 0;
}

static void demo_tick(struct demo_source *d, struct transmitter *t, uint32_t now)
{
	struct gp_frame f = {.session = t->session};
	uint16_t buttons = demo_buttons(now, &t->status);
	if (t->phase == OFFLINE) {
		*d = (struct demo_source){0};
		f.type = GP_HELLO;
		f.data.hello_nonce = air_nonce();
		tx_source(t, &f, now);
		return;
	}
	if (t->phase == OFFERED) {
		f.type = GP_SYNC;
		f.data.input.buttons = buttons;
		d->last_buttons = buttons;
		d->last_heartbeat = now;
		tx_source(t, &f, now);
	}
	if (t->phase < SYNCING) return;
	if (t->status.flags & GP_USB_DONE_VALID) d->released = t->status.usb_done;
	if (buttons != d->last_buttons) {
		if ((uint16_t)(d->produced - d->released) == GP_QUEUE_SIZE) {
			tx_reset(t, GP_OVERFLOW);
			return;
		}
		d->produced++;
		d->queue[d->produced % GP_QUEUE_SIZE] =
			(struct gp_input){.seq = d->produced, .buttons = buttons};
		d->last_buttons = buttons;
	}
	if (t->phase == ACTIVE && t->status.tx_accept != d->produced) {
		f.type = GP_INPUT;
		f.data.input = d->queue[(uint16_t)(t->status.tx_accept + 1) % GP_QUEUE_SIZE];
		tx_source(t, &f, now);
	}
	if (now - d->last_heartbeat >= GP_HEARTBEAT_MS) {
		d->last_heartbeat = now;
		f.type = GP_HEARTBEAT;
		/* No downstream Hitbox OUT in stage 2: never claim a physical LED apply. */
		f.data.heartbeat = (struct gp_heartbeat){.number = ++d->heartbeat};
		tx_source(t, &f, now);
	}
}

#endif

int main(void)
{
	static struct transmitter tx;
#ifdef BRIDGE_DEMO
	static struct demo_source demo;
	bool external = false;
#endif
	tx_reset(&tx, GP_REBOOT);
	match_init(BRIDGE_TX);
	int rc = match_usb_open(0);
	if (rc) return rc;
	rc = air_start(false);
	if (rc) return rc;
	rc = spi_init();
	if (rc) return rc;
	rc = spi_arm(&tx.reset);
	if (rc) return rc;
	for (;;) {
		uint32_t now = k_uptime_get_32();
		tx_tick(&tx, now);
		struct gp_frame frame;
		while (air_receive(&frame)) tx_ack(&tx, &frame, now);
		int transaction = spi_take(&frame);
		if (transaction > 0) {
#ifdef BRIDGE_DEMO
			if (frame.type == GP_HELLO) external = true;
			if (external)
#endif
				tx_source(&tx, &frame, now);
		}
#ifdef BRIDGE_DEMO
		if (!external) demo_tick(&demo, &tx, now);
#endif
		if (transaction) {
			struct gp_frame reply = tx_reply(&tx);
			rc = spi_arm(&reply);
			if (rc) return rc;
		}
		tx_schedule(&tx, k_ticks_to_us_floor32(k_uptime_ticks()), air_send);
		match_usb_service();
		k_sleep(K_USEC(200));
	}
}
```

## src/spi.c
```c
/* SPDX-License-Identifier: MIT */
#include "spi.h"
#include <zephyr/kernel.h>
#include <nrfx_spis.h>
#include <nrfx_gpiote.h>
#include <nrfx_ppi.h>
#include <hal/nrf_gpio.h>
#include <hal/nrf_gpiote.h>

enum { SCK = 20, MOSI = 17, MISO = 22, CS = 24, READY = 32 };
static const nrfx_spis_t device = NRFX_SPIS_INSTANCE(2);
static const nrfx_gpiote_t gpio_events = NRFX_GPIOTE_INSTANCE(0);
static uint8_t clear_on_cs, ready_task;
static struct {
	uint8_t tx[GP_WIRE_SIZE] __aligned(4);
	uint8_t rx[GP_WIRE_SIZE + 1] __aligned(4);
} dma[2];
static unsigned bank;
static atomic_t received; /* 0 waiting, otherwise byte count + 1 */

static void event(const nrfx_spis_evt_t *e, void *context)
{
	ARG_UNUSED(context);
	if (e->evt_type == NRFX_SPIS_BUFFERS_SET_DONE && nrf_gpio_pin_read(CS))
		NRF_GPIOTE->TASKS_SET[ready_task] = 1;
	if (e->evt_type == NRFX_SPIS_XFER_DONE)
		atomic_set(&received, 1 + e->rx_amount);
}

int spi_init(void)
{
	nrf_ppi_channel_t ppi;
	if (nrfx_gpiote_channel_alloc(&gpio_events, &clear_on_cs) ||
	    nrfx_gpiote_channel_alloc(&gpio_events, &ready_task) ||
	    nrfx_ppi_channel_alloc(&ppi)) return -ENOMEM;
	nrf_gpio_pin_clear(READY);
	nrf_gpio_cfg_output(READY);
	nrfx_spis_config_t cfg = NRFX_SPIS_DEFAULT_CONFIG(SCK, MOSI, MISO, CS);
	cfg.csn_pullup = NRF_GPIO_PIN_PULLUP;
	cfg.irq_priority = 3;
	IRQ_CONNECT(SPIM2_SPIS2_SPI2_IRQn, 3,
		    nrfx_spis_2_irq_handler, NULL, 0);
	if (nrfx_spis_init(&device, &cfg, event, NULL)) return -EIO;
	nrf_gpiote_event_configure(NRF_GPIOTE, clear_on_cs, CS, NRF_GPIOTE_POLARITY_HITOLO);
	nrf_gpiote_event_enable(NRF_GPIOTE, clear_on_cs);
	nrf_gpiote_task_configure(NRF_GPIOTE, ready_task, READY, NRF_GPIOTE_POLARITY_TOGGLE,
				  NRF_GPIOTE_INITIAL_VALUE_LOW);
	nrf_gpiote_task_enable(NRF_GPIOTE, ready_task);
	if (nrfx_ppi_channel_assign(ppi, (uint32_t)&NRF_GPIOTE->EVENTS_IN[clear_on_cs],
				   (uint32_t)&NRF_GPIOTE->TASKS_CLR[ready_task]) ||
	    nrfx_ppi_channel_enable(ppi)) return -EIO;
	return 0;
}

int spi_arm(const struct gp_frame *reply)
{
	bank ^= 1;
	if (!gp_encode(dma[bank].tx, GP_WIRE_SIZE, reply)) return -EINVAL;
	return nrfx_spis_buffers_set(&device, dma[bank].tx, sizeof(dma[bank].tx),
				     dma[bank].rx, sizeof(dma[bank].rx)) ? -EIO : 0;
}

int spi_take(struct gp_frame *frame)
{
	atomic_val_t count = atomic_set(&received, 0);
	if (!count) return 0;
	return gp_decode(frame, dma[bank].rx, count - 1) ? 1 : -1;
}
```

## src/transmitter.c
```c
/* SPDX-License-Identifier: MIT */
#include "transmitter.h"

void tx_reset(struct transmitter *t, enum gp_reset_reason reason)
{
	uint64_t old = t->session;
	uint32_t late = t->poll_overdue;
	*t = (struct transmitter){.reset = {old, GP_RESET, {.reset_reason = reason}},
				 .notify_reset = old != 0, .poll_overdue = late};
}

void tx_tick(struct transmitter *t, uint32_t now)
{
	if (t->phase < SYNCING) return;
	bool outstanding = t->phase == SYNCING || t->status.tx_accept != t->status.usb_done;
	if (now - t->last_live >= GP_TIMEOUT_MS || now - t->last_peer >= GP_TIMEOUT_MS ||
	    (outstanding && now - t->last_progress >= GP_TIMEOUT_MS)) tx_reset(t, GP_TIMEOUT);
}

void tx_source(struct transmitter *t, const struct gp_frame *f, uint32_t now)
{
	struct gp_status *s = &t->status;
	if (f->type == GP_HELLO) {
		if (f->data.hello_nonce != t->nonce) {
			/* Only SYNC commits an offered session at RX. Preserve a genuine
			 * pending fault, but discovery itself must not reset the peer. */
			*t = (struct transmitter){.phase = DISCOVERY, .nonce = f->data.hello_nonce,
				.reset = t->reset, .notify_reset = t->notify_reset,
				.poll_overdue = t->poll_overdue};
		}
		return;
	}
	if (!t->session || f->session != t->session) return;
	switch (f->type) {
	case GP_RESET:
		tx_reset(t, f->data.reset_reason);
		break;
	case GP_SYNC:
		if (t->phase != OFFERED) break;
		t->phase = SYNCING;
		t->sync = f->data.input;
		s->flags = GP_TX_ACCEPT_VALID;
		t->last_peer = t->last_live = t->last_progress = now;
		break;
	case GP_INPUT: {
		uint16_t seq = f->data.input.seq;
		if (t->phase != ACTIVE || seq != (uint16_t)(s->tx_accept + 1) ||
		    (uint16_t)(seq - s->usb_done) > GP_WINDOW) break;
		if (s->tx_accept == s->usb_done) t->last_progress = now;
		t->window[seq % GP_WINDOW] = f->data.input;
		s->tx_accept = seq;
		t->last_live = now;
		break;
	}
	case GP_HEARTBEAT: {
		uint32_t delta = f->data.heartbeat.number - t->heartbeat.number;
		if (t->phase < SYNCING || (t->heartbeat_valid && (!delta || delta >= 0x80000000U))) break;
		t->heartbeat = f->data.heartbeat;
		t->heartbeat_valid = t->heartbeat_pending = true;
		t->last_live = now;
		break;
	}
	default: break;
	}
}

/* Both distances are bounded by one live window. This also handles ffff -> 0000. */
static bool within(uint16_t value, uint16_t base, uint16_t limit)
{
	return (uint16_t)(value - base) <= (uint16_t)(limit - base);
}

void tx_ack(struct transmitter *t, const struct gp_frame *f, uint32_t now)
{
	if (f->type == GP_OFFER && t->phase == DISCOVERY && f->data.hello_nonce == t->nonce) {
		t->session = f->session;
		t->phase = OFFERED;
		return;
	}
	if (!t->session || f->session != t->session) return;
	if (f->type == GP_RESET) {
		tx_reset(t, f->data.reset_reason);
		t->notify_reset = false; /* RX already discarded this session. */
		return;
	}
	if (f->type != GP_STATUS || !t->sync_sent) return;
	const struct gp_status *ack = &f->data.status;
	struct gp_status *s = &t->status;
	if ((ack->flags & (GP_TX_ACCEPT_VALID | GP_RX_ACCEPT_VALID)) != GP_RX_ACCEPT_VALID ||
	    !within(ack->rx_accept, s->rx_accept, t->sent)) return;
	if ((ack->flags & GP_USB_DONE_VALID) &&
	    !within(ack->usb_done, s->usb_done, ack->rx_accept)) return;
	t->last_peer = now;
	s->flags |= GP_RX_ACCEPT_VALID;
	s->rx_accept = ack->rx_accept;
	if (ack->flags & GP_USB_DONE_VALID) {
		if (!(s->flags & GP_USB_DONE_VALID) || ack->usb_done != s->usb_done)
			t->last_progress = now;
		s->flags |= GP_USB_DONE_VALID;
		s->usb_done = ack->usb_done;
		t->phase = ACTIVE;
	}
	if (ack->flags & GP_LED_VALID) {
		uint16_t advance = (uint16_t)(ack->led_gen - s->led_gen);
		if (!(s->flags & GP_LED_VALID) || advance < 0x8000) {
			s->flags |= GP_LED_VALID;
			s->led_gen = ack->led_gen;
			s->led_mode = ack->led_mode;
		}
	}
}

struct gp_frame tx_reply(const struct transmitter *t)
{
	if (t->phase < OFFERED) return t->reset;
	if (t->phase == OFFERED)
		return (struct gp_frame){t->session, GP_OFFER, {.hello_nonce = t->nonce}};
	return (struct gp_frame){t->session, GP_STATUS, {.status = t->status}};
}

bool tx_schedule(struct transmitter *t, uint32_t now_us, bool (*send)(const struct gp_frame *))
{
	uint32_t elapsed = now_us - t->last_air_us;
	struct gp_status *s = &t->status;
	struct gp_frame f = {.session = t->session};
	bool waiting = t->phase == SYNCING || (t->phase == ACTIVE && s->tx_accept != s->usb_done);
	if (t->notify_reset) {
		f = t->reset;
	} else if (t->phase == DISCOVERY || t->phase == OFFERED) {
		if (elapsed < GP_POLL_TARGET_US) return false;
		f = (struct gp_frame){0, GP_HELLO, {.hello_nonce = t->nonce}};
	} else if (t->phase < SYNCING) {
		return false;
	} else if (t->heartbeat_pending && t->sync_sent) {
		f.type = GP_HEARTBEAT;
		f.data.heartbeat = t->heartbeat;
	} else if (t->phase == SYNCING && !(s->flags & GP_RX_ACCEPT_VALID)) {
		if (t->sync_sent && elapsed < GP_POLL_TARGET_US) return false;
		f.type = GP_SYNC;
		f.data.input = t->sync;
	} else if (t->phase == ACTIVE && t->sent != s->tx_accept) {
		f.type = GP_INPUT;
		f.data.input = t->window[(uint16_t)(t->sent + 1) % GP_WINDOW];
	} else {
		if (!waiting || elapsed < GP_POLL_TARGET_US) return false;
		if (s->rx_accept != t->sent) {
			f.type = GP_INPUT;
			f.data.input = t->window[(uint16_t)(s->rx_accept + 1) % GP_WINDOW];
		} else {
			f.type = GP_POLL;
		}
	}
	if (!send(&f)) return false;
	if (waiting && elapsed > GP_POLL_LIMIT_US) t->poll_overdue++;
	t->last_air_us = now_us;
	if (f.type == GP_RESET) t->notify_reset = false;
	if (f.type == GP_SYNC) t->sync_sent = true;
	if (f.type == GP_HEARTBEAT) t->heartbeat_pending = false;
	if (f.type == GP_INPUT && f.data.input.seq == (uint16_t)(t->sent + 1))
		t->sent = f.data.input.seq;
	return true;
}
```

## src/transmitter.h
```c
/* SPDX-License-Identifier: MIT */
#ifndef BRIDGE_TRANSMITTER_H
#define BRIDGE_TRANSMITTER_H
#include "protocol.h"

enum tx_phase { OFFLINE, DISCOVERY, OFFERED, SYNCING, ACTIVE };
struct transmitter {
	enum tx_phase phase;
	uint64_t nonce, session;
	struct gp_frame reset;
	bool notify_reset, sync_sent, heartbeat_pending, heartbeat_valid;
	struct gp_heartbeat heartbeat;
	struct gp_input sync, window[GP_WINDOW];
	struct gp_status status;
	uint16_t sent;
	uint32_t last_live, last_peer, last_progress, last_air_us, poll_overdue;
};

void tx_reset(struct transmitter *t, enum gp_reset_reason reason);
void tx_tick(struct transmitter *t, uint32_t now);
void tx_source(struct transmitter *t, const struct gp_frame *f, uint32_t now);
void tx_ack(struct transmitter *t, const struct gp_frame *f, uint32_t now);
struct gp_frame tx_reply(const struct transmitter *t);
bool tx_schedule(struct transmitter *t, uint32_t now_us, bool (*send)(const struct gp_frame *));
#endif
```
