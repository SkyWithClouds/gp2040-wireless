## CMakeLists.txt
```
cmake_minimum_required(VERSION 3.20.0)
set(BRIDGE_STAGE "xinput" CACHE STRING "Bridge integration stage")
if(BRIDGE_STAGE MATCHES "^(esb|full)$")
  set(EXTRA_CONF_FILE esb.conf)
elseif(NOT BRIDGE_STAGE STREQUAL "xinput")
  message(FATAL_ERROR "The receiver supports xinput, esb and full")
endif()
find_package(Zephyr REQUIRED HINTS $ENV{ZEPHYR_BASE})
project(bridge_xinput)
# Pinned legacy USB stack supplies OS 1.0 registration and descriptor fixup.
target_include_directories(app PRIVATE ${ZEPHYR_BASE}/subsys/usb/device)
target_sources(app PRIVATE src/reports.c)
if(BRIDGE_STAGE MATCHES "^(esb|full)$")
  target_compile_definitions(app PRIVATE BRIDGE_ESB=1)
  target_include_directories(app PRIVATE ../common)
  target_sources(app PRIVATE ../common/air.c ../common/match.c ../common/match_usb.c src/multi.c src/receiver.c)
else()
  target_sources(app PRIVATE src/main.c)
endif()
```

## prj.conf
```kconfig
CONFIG_USB_DEVICE_STACK=y
CONFIG_USB_DEVICE_OS_DESC=y
# pid.codes private test identity only; replace before distributing hardware.
CONFIG_USB_DEVICE_VID=0x1209
CONFIG_USB_DEVICE_PID=0x0001
CONFIG_USB_DEVICE_MANUFACTURER="GP2040 Wireless"
CONFIG_USB_DEVICE_PRODUCT="XInput Receiver Stage 1"
CONFIG_USB_SELF_POWERED=n
CONFIG_CONSOLE=n
CONFIG_SERIAL=n
CONFIG_LOG=n
```

## esb.conf
```kconfig
CONFIG_ESB=y
CONFIG_ENTROPY_GENERATOR=y
CONFIG_ENTROPY_DEVICE_RANDOM_GENERATOR=y
CONFIG_USB_DEVICE_PRODUCT="XInput Receiver ESB"

CONFIG_FLASH=y
CONFIG_FLASH_MAP=y
CONFIG_FLASH_PAGE_LAYOUT=y
CONFIG_NVS=y
CONFIG_NVS_DATA_CRC=y
CONFIG_ESB_TX_FIFO_SIZE=32
CONFIG_ESB_RX_FIFO_SIZE=32
```

## app.overlay
```dts
/* Keep the original bootloader storage untouched. Carve NVS from our app area. */
&application { reg = <0x26000 0xc2000>; };
&{/soc/flash-controller@4001e000/flash@0/partitions} {
    hitbox_nvs: partition@e8000 { label = "hitbox-nvs"; reg = <0xe8000 0x4000>; };
};
```

## src/main.c
```c
/* SPDX-License-Identifier: MIT */
#include <zephyr/kernel.h>
#include <zephyr/sys/atomic.h>
#include <zephyr/sys/byteorder.h>
#include <zephyr/usb/usb_device.h>
#include <os_desc.h>
#include <usb_descriptor.h>

#include "reports.h"
#ifdef BRIDGE_ESB
#include "air.h"
#include "receiver.h"
static atomic_t bus_epoch;
static atomic_t completions;
#endif

enum { EP_IN = 0x81, EP_OUT = 0x02, MPS = 32, MS_REQUEST = 0x20 };

struct xinput_descriptors {
	struct usb_if_descriptor iface;
	uint8_t capabilities[17];
	struct usb_ep_descriptor in;
	struct usb_ep_descriptor out;
} __packed;

USBD_CLASS_DESCR_DEFINE(primary, 0) struct xinput_descriptors descriptors = {
	.iface = {
		.bLength = sizeof(struct usb_if_descriptor),
		.bDescriptorType = USB_DESC_INTERFACE,
		.bNumEndpoints = 2,
		.bInterfaceClass = 0xff, .bInterfaceSubClass = 0x5d, .bInterfaceProtocol = 1,
	},
	.capabilities = {
		17, 0x21, 0x00, 0x01, 0x01, 0x25, EP_IN, 20,
		0, 0, 0, 0, 0x13, EP_OUT, 8, 0, 0
	},
	.in = {
		.bLength = sizeof(struct usb_ep_descriptor), .bDescriptorType = USB_DESC_ENDPOINT,
		.bEndpointAddress = EP_IN, .bmAttributes = USB_DC_EP_INTERRUPT,
		.wMaxPacketSize = sys_cpu_to_le16(MPS), .bInterval = 1,
	},
	.out = {
		.bLength = sizeof(struct usb_ep_descriptor), .bDescriptorType = USB_DESC_ENDPOINT,
		.bEndpointAddress = EP_OUT, .bmAttributes = USB_DC_EP_INTERRUPT,
		.wMaxPacketSize = sys_cpu_to_le16(MPS), .bInterval = 8,
	},
};

static uint8_t ms_string[] = {
	18, USB_DESC_STRING, 'M', 0, 'S', 0, 'F', 0, 'T', 0, '1', 0, '0', 0, '0', 0,
	MS_REQUEST, 0,
};
static uint8_t compatible_id[40] = {
	40, 0, 0, 0, 0, 1, 4, 0, 1, /* length, version 1.00, index 4, one function */
	[16] = 0, 1, 'X', 'U', 'S', 'B', '1', '0', /* interface 0, Reserved1, ID */
};
static struct usb_os_descriptor os = {
	.string = ms_string, .string_len = sizeof(ms_string), .vendor_code = MS_REQUEST,
	.compat_id = compatible_id, .compat_id_len = sizeof(compatible_id),
};

static atomic_t configured;
static atomic_t suspended;
static atomic_t in_flight;
static atomic_t sequence_start;
/* Atomic OUT snapshot: valid bit 24, generation 8..23, mode 0..7. */
static atomic_t player_led;
static uint8_t report[XINPUT_REPORT_BYTES];

static void on_out(uint8_t ep, enum usb_dc_ep_cb_status_code status)
{
	uint8_t packet[MPS], mode;
	uint32_t length;
	if (status != USB_DC_EP_DATA_OUT || usb_read(ep, packet, sizeof(packet), &length)) {
		return;
	}
	/* usb_read also re-arms OUT, including after rumble or malformed commands. */
	if (parse_player_led(packet, length, &mode)) {
		uint16_t gen = (uint16_t)(((uint32_t)atomic_get(&player_led) >> 8) + 1u);
		atomic_set(&player_led, BIT(24) | ((uint32_t)gen << 8) | mode);
	}
}

static void on_in(uint8_t ep, enum usb_dc_ep_cb_status_code status)
{
	ARG_UNUSED(ep);
	if (status == USB_DC_EP_DATA_IN) {
#ifdef BRIDGE_ESB
		atomic_inc(&completions);
#endif
		atomic_clear(&in_flight);
	}
}

static void on_usb_status(enum usb_dc_status_code status, const uint8_t *param)
{
	switch (status) {
	case USB_DC_CONFIGURED:
#ifdef BRIDGE_ESB
		atomic_inc(&bus_epoch);
#endif
		atomic_set(&sequence_start, k_uptime_get_32());
		atomic_clear(&in_flight);
		atomic_clear(&suspended);
		atomic_set(&configured, param && *param);
		break;
	case USB_DC_RESET:
	case USB_DC_DISCONNECTED:
#ifdef BRIDGE_ESB
		atomic_inc(&bus_epoch);
#endif
		atomic_clear(&configured);
		atomic_clear(&in_flight);
		atomic_clear(&player_led);
		break;
	case USB_DC_SUSPEND: atomic_set(&suspended, 1); break;
	case USB_DC_RESUME: atomic_clear(&suspended); break;
	default: break;
	}
}

static struct usb_ep_cfg_data endpoints[] = {
	{ .ep_cb = on_in, .ep_addr = EP_IN },
	{ .ep_cb = on_out, .ep_addr = EP_OUT },
};

USBD_DEFINE_CFG_DATA(xinput) = {
	.interface_descriptor = &descriptors.iface,
	.num_endpoints = ARRAY_SIZE(endpoints),
	.endpoint = endpoints,
};

#ifdef BRIDGE_ESB
static void stream_radio(void)
{
	struct receiver rx = {.neutral = true};
	struct delivery pending;
	bool submitted = false;
	atomic_val_t epoch = atomic_get(&bus_epoch), baseline = 0;
	for (;;) {
		uint32_t now = k_uptime_get_32();
		atomic_val_t current = atomic_get(&bus_epoch);
		if (epoch != current) {
			receiver_reset(&rx);
			submitted = false;
			epoch = current;
		}
		receiver_tick(&rx, now);
		if (submitted && atomic_get(&completions) != baseline) {
			receiver_complete(&rx, &pending, now);
			submitted = false;
		}
		struct gp_frame f;
		while (air_receive(&f)) {
			if (!atomic_get(&configured) || f.type == GP_STATUS || f.type == GP_OFFER)
				continue;
			struct gp_frame reply = receiver_frame(&rx, &f, now, atomic_get(&player_led),
							       air_nonce);
			air_send(&reply); /* Next PTX packet clocks out this cumulative response. */
		}
		if (!submitted && atomic_get(&configured) && !atomic_get(&suspended) &&
		    receiver_peek(&rx, &pending) && atomic_cas(&in_flight, 0, 1)) {
			struct gp_input *s = &pending.input;
			memset(report, 0, sizeof(report));
			report[1] = sizeof(report);
			sys_put_le16(s->buttons, report + 2);
			report[4] = s->lt;
			report[5] = s->rt;
			sys_put_le16(s->lx, report + 6);
			sys_put_le16(s->ly, report + 8);
			sys_put_le16(s->rx, report + 10);
			sys_put_le16(s->ry, report + 12);
			uint32_t written;
			baseline = atomic_get(&completions);
			if (usb_write(EP_IN, report, sizeof(report), &written) || written != sizeof(report))
				atomic_clear(&in_flight);
			else
				submitted = true;
		}
		k_sleep(K_USEC(250));
	}
}
#endif

int main(void)
{
	/* The legacy core allocates the first free endpoint in each direction.
	 * It runs its fixup once. Restore the single-interface XUSB addresses in
	 * both tables before enabling USBD and registering endpoint callbacks. */
	if (!usb_get_device_descriptor()) {
		return -EINVAL;
	}
	descriptors.in.bEndpointAddress = EP_IN;
	endpoints[0].ep_addr = EP_IN;
	descriptors.out.bEndpointAddress = EP_OUT;
	endpoints[1].ep_addr = EP_OUT;
	usb_register_os_desc(&os);
	int err = usb_enable(on_usb_status);
	if (err) {
		return err;
	}

#ifdef BRIDGE_ESB
	err = air_start(true);
	if (err) return err;
	stream_radio();
#else
	for (;;) {
		if (atomic_get(&configured) && !atomic_get(&suspended) &&
		    atomic_cas(&in_flight, 0, 1)) {
			uint32_t elapsed = k_uptime_get_32() - (uint32_t)atomic_get(&sequence_start);
			demo_report(report, elapsed / 1000u, (uint8_t)atomic_get(&player_led));
			uint32_t written;
			if (usb_write(EP_IN, report, sizeof(report), &written) ||
			    written != sizeof(report)) {
				atomic_clear(&in_flight);
			}
		}
		k_sleep(K_MSEC(1));
	}
#endif
	return 0;
}
```

## src/hub.h
```c
/* SPDX-License-Identifier: MIT */
#pragma once
#include "match.h"
#include "receiver.h"
static inline bool hub_route(struct receiver receivers[4],struct rf_stats counters[4],
    unsigned slots,uint8_t pipe,struct gp_frame f,uint32_t now,uint32_t lamp,
    uint64_t (*nonce)(void),struct gp_frame *reply)
{
    if(pipe<1 || pipe>slots || f.type==GP_STATUS || f.type==GP_OFFER) return false;
    struct receiver *rx=&receivers[pipe-1];
    struct rf_stats *stats=&counters[pipe-1];
    stats->frames++;
    if(f.session && f.session==rx->session) {
        if(f.type==GP_HEARTBEAT && rx->heartbeat_valid) {
            uint32_t delta=f.data.heartbeat.number-rx->heartbeat;
            if(delta>1 && delta<0x80000000u) stats->gaps+=delta-1;
        }
        if(f.type==GP_INPUT && (uint16_t)(rx->accepted-f.data.input.seq)<GP_WINDOW)
            stats->duplicates++;
    }
    *reply=receiver_frame(rx,&f,now,lamp,nonce);
    return true;
}
```

## src/multi.c
```c
/* SPDX-License-Identifier: MIT */
#include <zephyr/kernel.h>
#include "air.h"
#include "hub.h"
#include "match_usb.h"
struct lane {

    struct delivery transfer;
    unsigned completion;
    bool submitted;
};
static struct lane lanes[4];
static struct receiver receivers[4];
static void tick_lane(unsigned i,uint32_t now)
{
    struct lane *l=&lanes[i];
    bool online=receivers[i].session!=0;
    receiver_tick(&receivers[i],now);
    if(online && !receivers[i].session) match_stats[i].timeouts++;
    if(l->submitted && match_usb_completions(i)!=l->completion) {
        receiver_complete(&receivers[i],&l->transfer,now);l->submitted=false;
    }
    if(!l->submitted && receiver_peek(&receivers[i],&l->transfer)) {
        l->completion=match_usb_completions(i);
        l->submitted=match_usb_submit(i,&l->transfer.input);
    }
    match_stats[i].online=receivers[i].session && receivers[i].done_valid;
}
int main(void)
{
    match_init(PC_RX);
    const unsigned slots=match_saved.slots;
    int rc=match_usb_open(slots);
    if(rc) return rc;
    rc=air_start(true);if(rc) return rc;
    unsigned epoch=~0u;
    for(;;) {
        uint32_t now=k_uptime_get_32();
        unsigned current=match_usb_epoch();
        if(current!=epoch) {
            epoch=current;
            for(unsigned i=0;i<slots;i++) {
                receiver_reset(&receivers[i]);lanes[i].submitted=false;
            }
        }
        for(unsigned i=0;i<slots;i++) tick_lane(i,now);
        struct gp_frame f;uint8_t pipe;
        while(air_receive_pipe(&pipe,&f)) {
            if(!match_usb_ready() || pipe<1 || pipe>slots || f.type==GP_STATUS || f.type==GP_OFFER) continue;
            struct gp_frame reply;
            if(!hub_route(receivers,match_stats,slots,pipe,f,now,match_usb_lamp(pipe-1),air_nonce,&reply))
                continue;
            air_send_pipe(pipe,&reply);
        }
        match_usb_service();k_sleep(K_USEC(180));
    }
}
```

## src/reports.c
```c
/* SPDX-License-Identifier: MIT */
#include "reports.h"
#include <string.h>

static void put16(uint8_t *p, uint16_t value)
{
	p[0] = (uint8_t)value;
	p[1] = (uint8_t)(value >> 8);
}

bool parse_player_led(const uint8_t *packet, size_t length, uint8_t *mode)
{
	if (length < 3 || packet[0] != 0x01 || packet[1] != 0x03) {
		return false;
	}
	*mode = packet[2];
	return true;
}

void demo_report(uint8_t out[XINPUT_REPORT_BYTES], unsigned step, uint8_t led_mode)
{
	memset(out, 0, XINPUT_REPORT_BYTES);
	out[1] = XINPUT_REPORT_BYTES;
	switch (step % DEMO_STEP_COUNT) {
	case 1: put16(out + 2, 0x1000); break; /* A */
	case 2: put16(out + 2, 0x3000); break; /* A+B in one report */
	case 3: put16(out + 2, 0x0008); break; /* D-pad right */
	case 4: out[4] = 255; break;
	case 5: out[5] = 255; break;
	case 6:
		put16(out + 6, 0x6000);
		put16(out + 8, 0xa000);
		put16(out + 10, 0xa000);
		put16(out + 12, 0x6000);
		break;
	case 7: {
		/* Diagnostic phase: display player 1..4 as A, B, X or Y. */
		unsigned first;
		if (led_mode >= 2 && led_mode <= 5) {
			first = 2;
		} else if (led_mode >= 6 && led_mode <= 9) {
			first = 6;
		} else {
			break;
		}
		put16(out + 2, (uint16_t)(0x1000u << (led_mode - first)));
		break;
	}
	default: break; /* neutral */
	}
}
```

## src/reports.h
```c
/* SPDX-License-Identifier: MIT */
#ifndef BRIDGE_XINPUT_REPORTS_H
#define BRIDGE_XINPUT_REPORTS_H

#include <stdbool.h>
#include <stddef.h>
#include <stdint.h>

enum { XINPUT_REPORT_BYTES = 20, DEMO_STEP_COUNT = 8 };
void demo_report(uint8_t out[XINPUT_REPORT_BYTES], unsigned step, uint8_t led_mode);
bool parse_player_led(const uint8_t *packet, size_t length, uint8_t *mode);

#endif
```
